## smaug_defconfig
```kconfig
# This image was built using git revision a925efa999a2a460c7c7504f886cd5ca728c33b5
# ! not found
CONFIG_VENDOR_GOOGLE=y
CONFIG_BOARD_SPECIFIC_OPTIONS=y
CONFIG_MAINBOARD_DIR="google/smaug"
CONFIG_MAINBOARD_PART_NUMBER="Smaug"
CONFIG_MAINBOARD_VENDOR="GOOGLE"
CONFIG_MAX_CPUS=4
CONFIG_RAMTOP=0x200000
CONFIG_HEAP_SIZE=0x4000
CONFIG_RAMBASE=0x100000
CONFIG_STACK_SIZE=0x1000
CONFIG_WARNINGS_ARE_ERRORS=y
CONFIG_UDELAY_IO=y
CONFIG_SERIAL_CPU_INIT=y
CONFIG_ACPI_SSDTX_NUM=0
CONFIG_DRAM_SIZE_MB=2048
CONFIG_VENDOR_SPECIFIC_OPTIONS=y
CONFIG_BOARD_GOOGLE_SMAUG=y
CONFIG_VBOOT_RAMSTAGE_INDEX=3
CONFIG_BOOT_MEDIA_SPI_BUS=0x7
CONFIG_EC_GOOGLE_CHROMEEC_I2C_BUS=0x1
CONFIG_BOOT_MEDIA_SPI_CHIP_SELECT=0
CONFIG_DRIVER_TPM_I2C_BUS=0x2
CONFIG_DRIVER_TPM_I2C_ADDR=0x20
CONFIG_FLASHMAP_OFFSET=0x300000
CONFIG_SMAUG_BCT_CFG_SPI=y
CONFIG_VBOOT_TEGRA_MTC_INDEX=0x6
CONFIG_VBOOT_SECURE_OS_INDEX=0x5
CONFIG_VBOOT_BL31_INDEX=0x4
CONFIG_BL31_SIZE_MB=0x1
CONFIG_VBOOT_ROMSTAGE_INDEX=2
CONFIG_LOGICAL_CPUS=y
CONFIG_DEFAULT_CONSOLE_LOGLEVEL=8
CONFIG_MAXIMUM_CONSOLE_LOGLEVEL=8
CONFIG_CPU_ADDR_BITS=36
CONFIG_BOARD_ROMSIZE_KB_16384=y
CONFIG_COREBOOT_ROMSIZE_KB_16384=y
CONFIG_COREBOOT_ROMSIZE_KB=16384
CONFIG_ROM_SIZE=0x1000000
CONFIG_ARCH_ARM=y
CONFIG_X86_BOOTBLOCK_SIMPLE=y
CONFIG_BOOTBLOCK_SOURCE="bootblock_simple.c"
# ! not found
CONFIG_IOAPIC_INTERRUPTS_ON_FSB=y
CONFIG_HPET_ADDRESS=0xfed00000
CONFIG_ID_SECTION_OFFSET=0x80
CONFIG_ARCH_BOOTBLOCK_ARM=y
CONFIG_ARCH_ROMSTAGE_ARM=y
CONFIG_ARCH_BOOTBLOCK_ARM_V4=y
CONFIG_ARCH_ROMSTAGE_ARM_V4=y
CONFIG_ARM_BOOTBLOCK_CUSTOM=y
CONFIG_ARCH_RAMSTAGE_ARM64=y
CONFIG_ARCH_RAMSTAGE_ARM_V8_64=y
CONFIG_ARCH_ARM64_CPU_CORTEX_A57=y
CONFIG_ARCH_ARM64_CORTEX_A57_POWER_DOWN_SUPPORT=y
CONFIG_ARM64_USE_ARM_TRUSTED_FIRMWARE=y
CONFIG_ARM64_USE_SECURE_OS=y
CONFIG_ARM64_SECURE_OS_FILE="3rdparty/mainboard/google/smaug/lk.bin"
CONFIG_ARM64_SECURE_OS_LOAD_RAW=y
CONFIG_BOOTBLOCK_CPU_INIT="soc/nvidia/tegra210/bootblock.c"
CONFIG_SMM_TSEG_SIZE=0
CONFIG_CBFS_SIZE=0x300000
CONFIG_SERIRQ_CONTINUOUS_MODE=y
CONFIG_FSP_CACHE_SIZE=0x0
CONFIG_ROMSTAGE_RAM_STACK_SIZE=0x5000
CONFIG_PLLX_KHZ=1300000
CONFIG_MAINBOARD_DO_DSI_INIT=y
CONFIG_TRUSTZONE_CARVEOUT_SIZE_MB=0x14
CONFIG_SOC_NVIDIA_TEGRA210=y
CONFIG_TTB_SIZE_MB=0x4
CONFIG_SEC_COMPONENT_SIZE_MB=0x10
CONFIG_HAVE_MTC=y
CONFIG_MTC_FILE="tegra_mtc.bin"
CONFIG_MTC_DIRECTORY="3rdparty/mainboard/google/smaug"
CONFIG_MTC_ADDRESS=0x81000000
CONFIG_COMPRESS_RAMSTAGE=y
CONFIG_XIP_ROM_SIZE=0x10000
CONFIG_HIGH_SCRATCH_MEMORY_SIZE=0x0
CONFIG_CACHE_ROM=y
CONFIG_VIDEO_MB=0
CONFIG_SPI_FLASH=y
CONFIG_EC_GOOGLE_CHROMEEC=y
CONFIG_EC_GOOGLE_CHROMEEC_I2C=y
CONFIG_EC_GOOGLE_CHROMEEC_I2C_CHIP=0x1e
CONFIG_EC_GOOGLE_CHROMEEC_I2C_PROTO3=y
CONFIG_LOCALVERSION=""
CONFIG_USE_FMAP=y
CONFIG_CBFS_PREFIX="fallback"
CONFIG_COMMON_CBFS_SPI_WRAPPER=y
CONFIG_COMPILER_GCC=y
CONFIG_INCLUDE_CONFIG_FILE=y
CONFIG_DYNAMIC_CBMEM=y
CONFIG_COLLECT_TIMESTAMPS=y
CONFIG_HAS_PRECBMEM_TIMESTAMP_REGION=y
CONFIG_GENERIC_GPIO_LIB=y
CONFIG_BOARD_ID_AUTO=y
CONFIG_RAM_CODE_SUPPORT=y
CONFIG_MAINBOARD_DO_NATIVE_VGA_INIT=y
CONFIG_PCI_BUS_SEGN_BITS=0
CONFIG_FRAMEBUFFER_VESA_MODE_117=y
CONFIG_FRAMEBUFFER_VESA_MODE=0x117
CONFIG_ELOG=y
CONFIG_ELOG_AREA_SIZE=0x1000
CONFIG_GIC=y
CONFIG_I2C_TPM=y
CONFIG_DRIVERS_MAXIM_MAX77620=y
CONFIG_DRIVERS_MAXIM_MAX77620_RTC=y
CONFIG_DRIVERS_MAXIM_MAX77620_RTC_BUS=4
CONFIG_DRIVERS_MAXIM_MAX77620_RTC_ADDR=0x68
CONFIG_SPI_FLASH_WINBOND=y
CONFIG_SPI_CONTROLLER_BYTE_LIMIT=64
CONFIG_TPM=y
CONFIG_BOOTBLOCK_CONSOLE=y
CONFIG_EARLY_CONSOLE=y
CONFIG_CONSOLE_CBMEM=y
CONFIG_CONSOLE_FIXED_PRERAM_CBMEM_BUFFER=y
CONFIG_CONSOLE_CBMEM_BUFFER_SIZE=0x10000
CONFIG_MAXIMUM_CONSOLE_LOGLEVEL_8=y
CONFIG_DEFAULT_CONSOLE_LOGLEVEL_8=y
CONFIG_HAVE_UART_MEMORY_MAPPED=y
CONFIG_HAVE_UART_SPECIAL=y
CONFIG_HAVE_HARD_RESET=y
CONFIG_HAVE_MONOTONIC_TIMER=y
CONFIG_GENERIC_UDELAY=y
CONFIG_CACHE_ROM_SIZE=0x300000
CONFIG_MAX_PIRQ_LINKS=4
CONFIG_PAYLOAD_NONE=y
CONFIG_CHROMEOS=y
CONFIG_CHROMEOS_VBNV_FLASH=y
CONFIG_CHROMEOS_RAMOOPS=y
CONFIG_CHROMEOS_RAMOOPS_NON_ACPI=y
CONFIG_CHROMEOS_RAMOOPS_RAM_START=0x00f00000
CONFIG_CHROMEOS_RAMOOPS_RAM_SIZE=0x00100000
CONFIG_EC_SOFTWARE_SYNC=y
CONFIG_VIRTUAL_DEV_SWITCH=y
CONFIG_VBOOT_BOOT_LOADER_INDEX=0x0
CONFIG_VBOOT2_VERIFY_FIRMWARE=y
CONFIG_MAX_REBOOT_CNT=3
```

## src/drivers/maxim/max77620/Kconfig
```kconfig
##
## This file is part of the coreboot project.
##
## Copyright 2015 Google Inc.
##
## This program is free software; you can redistribute it and/or modify
## it under the terms of the GNU General Public License as published by
## the Free Software Foundation; version 2 of the License.
##
## This program is distributed in the hope that it will be useful,
## but WITHOUT ANY WARRANTY; without even the implied warranty of
## MERCHANTABILITY or FITNESS FOR A PARTICULAR PURPOSE.  See the
## GNU General Public License for more details.
##
## You should have received a copy of the GNU General Public License
## along with this program; if not, write to the Free Software
## Foundation, Inc., 51 Franklin St, Fifth Floor, Boston, MA 02110-1301 USA
##

config DRIVERS_MAXIM_MAX77620
       bool "Maxim MAX77620 support"
       default n

config DRIVERS_MAXIM_MAX77620_RTC
       bool "Maxim MAX77620 RTC support"
       default n
       select DRIVERS_MAXIM_MAX77620

config DRIVERS_MAXIM_MAX77620_RTC_BUS
       int "Maxim MAX77620 RTC bus"
       depends on DRIVERS_MAXIM_MAX77620_RTC

config DRIVERS_MAXIM_MAX77620_RTC_ADDR
       hex "Maxim MAX77620 RTC chip address"
       depends on DRIVERS_MAXIM_MAX77620_RTC
```
